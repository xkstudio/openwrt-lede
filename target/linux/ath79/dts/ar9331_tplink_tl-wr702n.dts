// SPDX-License-Identifier: GPL-2.0-or-later OR MIT

#include "ar9331_tplink_tl-wr702n.dtsi"

/ {
	model = "TP-Link TL-WR702N";
	compatible = "tplink,tl-wr702n", "qca,ar9331";
};

&reg_usb_vbus {
	gpio = <&gpio 8 GPIO_ACTIVE_HIGH>;
};
